## conf/layer.conf
```bitbake
# We have a conf and classes directory, append to BBPATH
BBPATH .= ":${LAYERDIR}"

# We have a recipes directory, add to BBFILES
BBFILES += "${LAYERDIR}/recipes*/*/*.bb \
            ${LAYERDIR}/recipes*/*/*.bbappend \
            ${LAYERDIR}/images/*.bb"

BBFILE_COLLECTIONS += "rpi4linux-addon"
BBFILE_PATTERN_rpi4linux-addon := "^${LAYERDIR}/"
BBFILE_PRIORITY_rpi4linux-addon = "6"

LAYERSERIES_COMPAT_rpi4linux-addon = "dunfell"
```
